## app/boards/arm/itsybitsy_nrf52840/Kconfig.board
```kconfig
# Maker Diary nrf52840 M.2 board configuration
#
# Copyright (c) 2020 The ZMK Contributors
# SPDX-License-Identifier: MIT
#

config BOARD_ITSYBITSY_NRF52840
	bool "itsybitsy_nrf52480"
	depends on SOC_NRF52840_QIAA
```

## app/boards/shields/azarashi64/Kconfig.defconfig
```kconfig
# Copyright (c) 2020 The ZMK Contributors
# SPDX-License-Identifier: MIT

if SHIELD_AZARASHI64_LEFT

config ZMK_KEYBOARD_NAME
    default "Azarashi64 Left"

endif

if SHIELD_AZARASHI64_RIGHT

config ZMK_KEYBOARD_NAME
    default "Azarashi64 Right"

endif
```

## app/boards/shields/azarashi64/Kconfig.shield
```kconfig
# Copyright (c) 2020 The ZMK Contributors
# SPDX-License-Identifier: MIT

config SHIELD_AZARASHI64_LEFT
    def_bool $(shields_list_contains,azarashi64_left)

config SHIELD_AZARASHI64_RIGHT
    def_bool $(shields_list_contains,azarashi64_right)
```

## app/boards/shields/breadboard/Kconfig.defconfig
```kconfig
# Copyright (c) 2020 The ZMK Contributors
# SPDX-License-Identifier: MIT

if SHIELD_BREADBOARD_LEFT

config ZMK_KEYBOARD_NAME
    default "Breadboard Left"

endif

if SHIELD_BREADBOARD_RIGHT

config ZMK_KEYBOARD_NAME
    default "Breadboard Right"

endif
```

## app/boards/shields/breadboard/Kconfig.shield
```kconfig
# Copyright (c) 2020 The ZMK Contributors
# SPDX-License-Identifier: MIT

config SHIELD_BREADBOARD_LEFT
    def_bool $(shields_list_contains,breadboard_left)

config SHIELD_BREADBOARD_RIGHT
    def_bool $(shields_list_contains,breadboard_right)
```
