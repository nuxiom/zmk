/*
 * Copyright (c) 2020 The ZMK Contributors
 *
 * SPDX-License-Identifier: MIT
 */

#include "azarashi64.dtsi"

/ {
    /* This kscan is for the 60% left half without macro keys the
     * macro pad layout may require different column and row pins
     */
    kscan0: kscan {
        compatible = "zmk,kscan-gpio-matrix";
        label = "KSCAN";
        diode-direction = "row2col";


        col-gpios
            = <&gpio0 4  (GPIO_ACTIVE_HIGH | GPIO_PULL_DOWN)>
            , <&gpio0 3  (GPIO_ACTIVE_HIGH | GPIO_PULL_DOWN)>
            , <&gpio0 25 (GPIO_ACTIVE_HIGH | GPIO_PULL_DOWN)>
            , <&gpio0 24 (GPIO_ACTIVE_HIGH | GPIO_PULL_DOWN)>
            , <&gpio1 8  (GPIO_ACTIVE_HIGH | GPIO_PULL_DOWN)>
            , <&gpio0 7  (GPIO_ACTIVE_HIGH | GPIO_PULL_DOWN)>
            ;

        row-gpios
            = <&gpio0 31 (GPIO_ACTIVE_HIGH)>
            , <&gpio0 2  (GPIO_ACTIVE_HIGH)>
            , <&gpio0 5  (GPIO_ACTIVE_HIGH)>
            , <&gpio0 26 (GPIO_ACTIVE_HIGH)>
            , <&gpio0 11 (GPIO_ACTIVE_HIGH)>
            ;
    };
};
